#include "OLED.h"
/*宽6像素，高8像素*/
const uint8_t OLED_F6x8[][6] = 
{
	0x00,0x00,0x00,0x00,0x00,0x00,//   0
	0x00,0x00,0x00,0x2F,0x00,0x00,// ! 1
	0x00,0x00,0x07,0x00,0x07,0x00,// " 2
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	0x00,0x08,0x04,0x08,0x10,0x08,// ~ 94
};
void OLED_Send(uint8_t*command,uint16_t num)//命令数组需以0x00开头 数据数组需以0x40开头
{
	HAL_I2C_Master_Transmit(&hi2c1,0x78,command,num,HAL_MAX_DELAY);
}
void OLED_SetPosition(uint8_t y,uint8_t x)//x>=0&&x<=127 y>=0&&y<=7 
{
  uint8_t command[]={0x00,0x0f&x,0x10|((0xf0&x)>>4),0xb0|y};
  OLED_Send(command,sizeof(command));
}
void OLED_Init()
{
  uint8_t Init_command[]={0x00,0xae,0xd5,0x80,0xa8,0x3f,0xd3,0x00,0x40,0xa1,0xc8,0xda,0x12,0x81,0xcf,0xd9,0xf1,0xdb,0x30,0xa4,0xa6,0x8d,0x14,0xaf,};//第一个是0x00是发命令
  OLED_Send(Init_command,sizeof(Init_command));
  for(uint8_t j=0;j<8;j++)
  {
	  OLED_SetPosition(j,0);
	  uint8_t command[129]={0x40};
	  OLED_Send(command,129);
  }
}
void OLED_ShowChar(uint8_t y,uint8_t x,uint8_t Char)
{
	OLED_SetPosition(y,x);
	for(uint8_t i=0;i<6;i++)
	{
		uint8_t data[2]={0X40,OLED_F6x8[Char-' '][i]};
		OLED_Send(data,2);
    } 
}
void OLED_ShowString(uint8_t y,uint8_t x,uint8_t*string)
{
	OLED_SetPosition(y,x);
	for(uint16_t j=0;string[j]!='\0';j++)
	{
		for(uint8_t i=0;i<6;i++)
		{
			uint8_t data[2]={0X40,OLED_F6x8[string[j]-' '][i]};
			OLED_Send(data,2);
		} 
    }
}
void OLED_Clear()
{
  for(uint8_t j=0;j<8;j++)
  {
	  OLED_SetPosition(j,0);
	  uint8_t command[129]={0x40};
	  OLED_Send(command,129);
  }
}
void OLED_ShowFloat(uint8_t y,uint8_t x,float data)
{
	uint8_t String[32];
	sprintf(String,"%04.2f",data);
	OLED_ShowString(y,x,String);
}
void OLED_Reverse()
{
	uint8_t data[2]={0X00,0xa7};
	OLED_Send(data,2);
}
void OLED_Showint(uint8_t y,uint8_t x,int data)
{
	uint8_t String[16];
	sprintf(String,"%04d",data);
	OLED_ShowString(y,x,String);
}
void OLED_Sprintf(uint8_t y,uint8_t x,const char *format,...)
{
    char buffer[128];
    va_list args;
    va_start(args, format);
    vsprintf(buffer, format, args);
    va_end(args);
	OLED_ShowString(y,x,buffer);
}
